## sdkconfig.defaults
```kconfig
CONFIG_TINYUSB_CDC_ENABLED=y
CONFIG_FREERTOS_HZ=1000
CONFIG_ESP_INT_WDT_TIMEOUT_MS=9000
CONFIG_ESP_CONSOLE_NONE=y
CONFIG_ESP_CONSOLE_SECONDARY_NONE=y
CONFIG_TINYUSB_TASK_AFFINITY_CPU0=y
# CONFIG_TINYUSB_TASK_AFFINITY_CPU1 is not set
CONFIG_TINYUSB_TASK_AFFINITY=0x0
```
